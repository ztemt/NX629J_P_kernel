## drivers/hwmon/nubia_sensors/double_sensors/Kconfig
```kconfig
################################################# SENROS START
menuconfig NUBIA_DOUBLE_SENSORS
	tristate "NUBIA SENSORS ON"
	default n
	help
		nubia sensor
if NUBIA_DOUBLE_SENSORS
################################################# FRONT RGB START
config NUBIA_SENSORS_FRONT_RGB_BH1745
	tristate "support front rgb bh1745 driver"
	depends on NUBIA_DOUBLE_SENSORS
	default n
	help
		nubia front rgb device
################################################# BACK RGB&PS START
config NUBIA_SENSORS_BACK_TMD2725
	tristate "support back light/prox sensor driver"
	depends on NUBIA_DOUBLE_SENSORS
	default n
	help
		nubia ambient&&prox device of tmd2725
################################################# DOUBLE_PROXIMITY
config NUBIA_SENSORS_FRONT_PS_STK3332
	tristate "support front proximity driver"
	depends on NUBIA_DOUBLE_SENSORS
	default n
	help
		nubia device of front proximity
endif
```

## drivers/input/cs_press_f61/Kconfig
```kconfig
#
# Chipsea press keys driver configuration
#

config INPUT_CS_PRESS_F61
	tristate "chipsea press keys"
	depends on I2C
	help
	  This enables support for chipsea press keys driver.
```

## drivers/media/platform/msm/Kconfig
```kconfig
#
# MSM camera configuration
#

comment "Qualcomm Technologies, Inc. MSM Camera And Video"

menuconfig SPECTRA_CAMERA
    bool "Qualcomm Technologies, Inc. Spectra camera and video capture support"
    depends on ARCH_QCOM && VIDEO_V4L2 && I2C
    ---help---
      Say Y here to enable selecting the video adapters for
      Qualcomm Technologies, Inc. Spectra camera and video capture.
      Enabling this adds support for the camera driver stack including sensor,
      IFE and postprocessing drivers.

menuconfig MSM_AIS
    bool "Qualcomm Technologies, Inc. Automotive Imaging System"
    depends on ARCH_QCOM && VIDEO_V4L2 && I2C
    ---help---
      Say Y here to enable selecting the video adapters for
      Qualcomm Technologies, Inc. Aotomitive Imaging System.
      Enabling this adds support for the camera driver stack including sensor,
      IFE and postprocessing drivers.

config TCS3707
   tristate "tcs3707 awb sensor"
   depends on I2C
   help
    Say Y here if you want to use awb sensor
    through I2C interface.

    To compile this driver as a module, choose M here: the
    module will be called tcs3707.
	  
source "drivers/media/platform/msm/vidc/Kconfig"
source "drivers/media/platform/msm/sde/Kconfig"
source "drivers/media/platform/msm/npu/Kconfig"
source "drivers/media/platform/msm/dvb/Kconfig"
source "drivers/media/platform/msm/broadcast/Kconfig"
```

## drivers/nubia/fingerprint/Kconfig
```kconfig
################################################# FINGER_PRINTER START
config  NUBIA_SENSORS_FP
	tristate "NUBIA FP DEVICE"
	default y

source drivers/nubia/fingerprint/silead/Kconfig

if NUBIA_SENSORS_FP
source drivers/nubia/fingerprint/sunwave/Kconfig

source drivers/nubia/fingerprint/gf5288_right/Kconfig
source drivers/nubia/fingerprint/gf5288_left/Kconfig
choice
        prompt "choose the GF5216M device style"
        depends on NUBIA_SENSORS_FP_GF5288_RIGHT
        default NUBIA_SENSORS_FP_GF5288_RIGHT_PLATFORM
        help
           GF5216M need to select the work style

config NUBIA_SENSORS_FP_GF5288_RIGHT_SPI
        bool "GF5216M work as SPI device"
        help
          If you want GF5216M work as SPI device, select it.

config NUBIA_SENSORS_FP_GF5288_RIGHT_PLATFORM
        bool "GF5216M work as PLATFORM device"
        help
          If you want GF5216M work as PLATFORM device, select it.

endchoice
choice
        prompt "choose the GF5216M device style"
        depends on NUBIA_SENSORS_FP_GF5288_LEFT
        default NUBIA_SENSORS_FP_GF5288_LEFT_PLATFORM
        help
           GF5216M need to select the work style

config NUBIA_SENSORS_FP_GF5288_LEFT_SPI
        bool "GF5216M work as SPI device"
        help
          If you want GF5216M work as SPI device, select it.

config NUBIA_SENSORS_FP_GF5288_LEFT_PLATFORM
        bool "GF5216M work as PLATFORM device"
        help
          If you want GF5216M work as PLATFORM device, select it.

endchoice
endif
```

## drivers/nubia/fingerprint/sunwave/Kconfig
```kconfig
config FINGERPRINT_SUNWAVE
       tristate "Sunwave Fingerprint"
       default n
       help
          SUNWAVECORP Fingerprint
```

## drivers/nubia/touch/Kconfig
```kconfig
config TOUCHSCREEN_SYNAPTICS_DSX
        tristate "NUBIA SYNAPTICS DEVICE"
        default n
if TOUCHSCREEN_SYNAPTICS_DSX
source "drivers/nubia/touch/synaptics_dsx/Kconfig"
endif

config TOUCHSCREEN_NUBIA_SYNAPTICS_DSX
        bool "config nubia synaptics dsx"
        default n
        help
          Say Y here if you have a nubia touchscreen hxchipset connected
          to your system.
	  If unsure, say N.
if TOUCHSCREEN_NUBIA_SYNAPTICS_DSX
source "drivers/nubia/touch/nubia_synaptics_dsx/Kconfig"
endif

config TOUCHSCREEN_GOODIX_GTX8
        tristate "NUBIA SYNAPTICS DEVICE"
        default n
if TOUCHSCREEN_GOODIX_GTX8
source "drivers/nubia/touch/goodix_touch/Kconfig"
endif

config TOUCHSCREEN_NUBIA_BACK_GOODIX
        tristate "NUBIA GOODIX BACK DEVICE"
        default n
if TOUCHSCREEN_NUBIA_BACK_GOODIX
source "drivers/nubia/touch/goodix_gtx8_back/Kconfig"
endif

config TOUCHSCREEN_NUBIA_FRONT_GOODIX
        tristate "NUBIA GOODIX FRONT DEVICE"
        default n
if TOUCHSCREEN_NUBIA_FRONT_GOODIX
source "drivers/nubia/touch/goodix_gtx8_front/Kconfig"
endif
```

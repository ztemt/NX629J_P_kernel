
qcom,csl_4900mAh {
	qcom,profile-revision = <24>;
	/* #csl_4900mAh*/
	qcom,max-voltage-uv = <4400000>;
	qcom,fg-cc-cv-threshold-mv = <4390>;
	qcom,nom-batt-capacity-mah = <5020>;
	qcom,fastchg-current-ma = <4800>;
	qcom,jeita-fcc-ranges = <0  110  1400000
				111 390  4800000
				391 440  3300000
				441 550  1000000>;
	qcom,jeita-fv-ranges = <0   110  4400000
				111 390  4400000
				391 440  4400000
				441 550  4400000>;
	//qcom,step-chg-ranges = <3400000  4200000  4900000
				//4201000  4400000  4900000>;
	qcom,batt-id-kohm = <100>;
	qcom,battery-beta = <4250>;
	qcom,therm-room-temp = <100000>;
	qcom,battery-type = "csl_4900mAh";
	qcom,therm-coefficients = <0x2318 0xd0c 0xdaf7 0xc556 0x848d>;
	qcom,therm-center-offset = <0x70>;
	qcom,therm-pull-up = <100>;
	qcom,rslow-normal-coeffs = <0x0d 0x0a 0xac 0x13>;
	qcom,rslow-low-coeffs = <0xd0 0x0d 0xe0 0x0a>;
	qcom,checksum = <0x656D>;
	qcom,gui-version = "PM855GUI - 1.0.0.13";
	qcom,fg-profile-data = [
		 09 00 8B E3
		 C1 DC E5 E2
		 DA DC 00 00
		 CA BD 83 8A
		 F8 87 3D 93
		 48 87 D2 87
		 1E 00 0D 0A
		 AC 13 F1 04
		 1D 02 CE 07
		 32 00 9B EA
		 92 E4 43 DA
		 A9 FB 65 E3
		 22 C3 5B 1A
		 3F 07 6D DC
		 60 00 41 00
		 44 00 3D 00
		 35 00 32 00
		 37 00 4A 00
		 43 00 44 00
		 44 00 60 00
		 40 00 3C 00
		 3F 00 3A 00
		 33 00 70 00
		 5D 64 45 00
		 44 00 4C 08
		 60 00 4E 00
		 52 00 71 10
		 5C 10 51 00
		 9D 28 71 50
		 5F 68 55 0A
		 52 00 D8 08
		 00 20 EE 0C
		 FD 02 E4 05
		 63 1C DF 03
		 0E 05 44 23
		 90 17 E1 42
		 E4 5D 23 02
		 64 10 57 21
		 CE 05 ED 0B
		 FA FC 04 1D
		 8A F9 03 05
		 96 03 D6 17
		 DE 23 56 44
		 5E 5A 8C 11
		 95 1F 80 E5
		 A5 D2 2B D4
		 DD 1C 49 C3
		 DD 04 CA BB
		 85 17 E0 8B
		 71 84 3B 9A
		 7E A0 09 80
		 37 E3 BA 0D
		 97 FA 75 05
		 00 00 F7 E5
		 8C EA F7 F7
		 61 D3 44 BD
		 3A 10 13 F0
		 71 D3 66 02
		 77 04 43 01
		 CE 07 32 00
		 70 01 19 03
		 04 05 56 03
		 7B 03 15 03
		 EB 02 9E 02
		 7B 04 4C 00
		 3B 00 40 00
		 42 64 47 00
		 47 00 49 08
		 49 F8 46 00
		 4B 00 3E 10
		 48 10 3E 00
		 48 28 49 48
		 52 60 60 0C
		 41 00 4E 00
		 57 08 65 00
		 55 00 44 00
		 40 08 4E 10
		 50 00 61 20
		 71 48 4B 58
		 58 0D 5F 00
		 61 00 3E 08
		 D8 00 05 20
		 99 05 4C 0A
		 1D 0D E6 1C
		 18 23 EC 45
		 2B 5A 80 18
		 35 02 49 05
		 4F 02 6D 0F
		 3F 0A D2 20
		 3C 04 8D 03
		 3E 05 D5 1C
		 E5 02 23 04
		 10 02 8E 18
		 FC 03 BC 05
		 90 03 73 00
		 03 20 14 05
		 05 03 AC 05
		 D3 1C 72 02
		 FD 04 5A 03
		 9F 18 68 03
		 9F 04 51 02
		 72 00 1A 01
		 C0 00 FA 00
		 00 14 00 00
	];
};

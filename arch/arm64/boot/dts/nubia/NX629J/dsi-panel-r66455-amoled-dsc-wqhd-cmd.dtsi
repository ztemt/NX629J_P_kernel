/* Copyright (c) 2015-2017, The Linux Foundation. All rights reserved.
 *
 * This program is free software; you can redistribute it and/or modify
 * it under the terms of the GNU General Public License version 2 and
 * only version 2 as published by the Free Software Foundation.
 *
 * This program is distributed in the hope that it will be useful,
 * but WITHOUT ANY WARRANTY; without even the implied warranty of
 * MERCHANTABILITY or FITNESS FOR A PARTICULAR PURPOSE.  See the
 * GNU General Public License for more details.
 */

&mdss_mdp {
	dsi_r66455_truly_dsc_cmd: qcom,mdss_dsi_r66455_dsc_cmd_truly {
		qcom,mdss-dsi-panel-name =
			"r66455 cmd mode dsi truly panel with DSC";
		qcom,mdss-dsi-panel-controller = <&mdss_dsi0>;
		qcom,mdss-dsi-panel-type = "dsi_cmd_mode";
		qcom,mdss-dsi-virtual-channel-id = <0>;
		qcom,mdss-dsi-stream = <0>;
		qcom,mdss-dsi-bpp = <24>;
		qcom,mdss-dsi-color-order = "rgb_swap_rgb";
		qcom,mdss-dsi-underflow-color = <0xff>;
		qcom,mdss-dsi-border-color = <0>;
		qcom,mdss-dsi-panel-blackness-level = <3230>;
		qcom,mdss-dsi-traffic-mode = "non_burst_sync_event";
		qcom,mdss-dsi-bllp-eof-power-mode;
		qcom,mdss-dsi-bllp-power-mode;
		qcom,mdss-dsi-lane-0-state;
		qcom,mdss-dsi-lane-1-state;
		qcom,mdss-dsi-lane-2-state;
		qcom,mdss-dsi-lane-3-state;
		qcom,mdss-dsi-dma-trigger = "trigger_sw";
		qcom,mdss-dsi-mdp-trigger = "none";
		qcom,mdss-dsi-reset-sequence =<1 2>, <0 2>, <1 60>;
		qcom,mdss-dsi-bl-pmic-control-type = "bl_ctrl_wled";
		qcom,mdss-dsi-bl-min-level = <19>;
		qcom,mdss-dsi-bl-max-level = <4095>;
		qcom,adjust-timer-wakeup-ms = <1>;
		qcom,mdss-dsi-te-pin-select = <1>;
		qcom,mdss-dsi-wr-mem-start = <0x2c>;
		qcom,mdss-dsi-wr-mem-continue = <0x3c>;
		qcom,mdss-dsi-te-dcs-command = <1>;
		qcom,mdss-dsi-te-check-enable;
		qcom,mdss-dsi-te-using-te-pin;
        qcom,mdss-dsi-t-clk-post = <0x12>;
        qcom,mdss-dsi-t-clk-pre = <0x28>;

		qcom,mdss-dsi-display-timings {
			timing@0{
				qcom,mdss-dsi-panel-framerate = <90>;
				qcom,mdss-dsi-panel-width = <1080>;
				qcom,mdss-dsi-panel-height = <2340>;
				qcom,mdss-dsi-h-front-porch = <95>;
				qcom,mdss-dsi-h-back-porch = <40>;
				qcom,mdss-dsi-h-pulse-width = <1>;
				qcom,mdss-dsi-h-sync-skew = <0>;
				qcom,mdss-dsi-v-back-porch = <4>;
				qcom,mdss-dsi-v-front-porch = <24>;
				qcom,mdss-dsi-v-pulse-width = <1>;
				qcom,mdss-dsi-h-left-border = <0>;
				qcom,mdss-dsi-h-right-border = <0>;
				qcom,mdss-dsi-v-top-border = <0>;
				qcom,mdss-dsi-v-bottom-border = <0>;
				qcom,mdss-dsi-on-command = [
					39 01 00 00 00 00 02 b0 04
					39 01 00 00 00 00 05 e4 01 00 00 00
					39 01 00 00 00 00 02 b0 00
					39 01 00 00 00 00 09 b3 00 00 02 02 08 00 10 00
					39 01 00 00 00 00 08 b6 02 db 07 00 1a 0a 1b
					39 01 00 00 00 00 02 b8 5a
					39 01 00 00 00 00 02 b9 71
					39 01 00 00 00 00 02 ba 85
					39 01 00 00 00 00 2f bb 59 ff ff ff ef cf ab 87 63 3f 4a 48 46 44 42 40 3e 3c 3a 00 ff ff ff ff ff ff ff ff ff 04 00 04 04 42 04 69 5a 00 0b 83 0f ff 0f ff 0f ff
					39 01 00 00 00 00 0c bc 45 26 c3 1f 19 06 03 c0 00 00 10
					39 01 00 00 00 00 0c bd 33 4c c3 52 32 1f 03 f2 00 00 13
					39 01 00 00 00 00 0c be 25 68 c3 aa 3f 32 03 ff 00 00 25
					39 01 00 00 00 00 0d c0 00 00 00 00 00 00 00 00 00 00 00 00
					39 01 00 00 00 00 19 c1 70 61 00 00 00 11 11 20 02 00 00 00 00 01 04 80 00 10 00 00 00 01 80 00
					39 01 00 00 00 00 0a c3 00 01 00 00 55 55 55 55 15
					39 01 00 00 00 00 20 c2 00 09 24 00 0c 00 32 00 0c 09 50 00 0c 00 32 00 0c 00 32 00 0c 00 32 09 24 00 02 00 00 00 6c
					39 01 00 00 00 00 1f c4 70 00 00 00 00 00 02 00 1c 00 1c 00 01 00 00 00 00 00 00 00 00 00 00 00 00 00 10 00 00 03
					39 01 00 00 00 00 0a c5 0a 00 4d 8b 4d 8b 4d 8b 00
					39 01 00 00 00 00 df cb 00 00 00 06 00 29 00 0c 00 50 00 0e 00 33 00 20 02 88 00 28 02 e1 00 30 03 38 00 60 04 5b 00 85 04 c8 00 c3 05 a0 01 53 06 d2 03 77 0a ab 0b ae 00 00 00 1c 02 9c 00 1e 02 92 00 1f 02 b6 00 30 03 4b 00 55 04 38 00 90 04 f3 00 ed 06 16 01 93 07 56 01 b5 07 8c 02 14 08 4c 03 2b 0a 36 0b d1 00 00 00 06 01 33 00 0c 02 63 00 0e 03 64 00 10 04 63 00 20 04 e5 00 30 05 55 00 6d 06 95 00 9c 07 23 01 00 08 88 02 3b 0a ea 03 aa 0d b7 0e 8e 00 00 00 00 00 00 00 00 00 00 00 00 00 00 00 00 00 00 00 00 00 00 00 00 00 00 00 00 00 00 00 00 00 00 00 00 00 00 00 00 00 00 00 00 00 00 00 00 00 00 00 00 00 00 00 00 00 00 00 00 00 00 00 00 00 00 00 00 00 00 00 00 00 00 00 00 00 00
					39 01 00 00 00 00 df cc 00 00 00 0a 00 a7 00 11 01 b4 00 1e 02 79 00 30 03 30 00 4a 03 fd 00 75 04 af 00 c9 05 d3 01 10 06 7d 01 2f 06 da 03 17 0a b9 03 fd 0c c6 0c a4 00 00 00 01 00 00 00 16 02 32 00 21 02 dc 00 30 03 53 00 46 03 f7 00 71 04 b1 00 bc 05 c2 01 1a 06 a9 01 1b 06 c2 02 f4 0a a1 03 fe 0d 02 0c d4 00 00 00 06 01 2b 00 0c 02 54 00 12 05 48 00 13 04 6e 00 24 05 0f 00 45 05 ca 00 56 06 22 00 70 06 a4 00 db 08 43 01 51 09 58 02 38 0b 62 0f 96 00 00 00 00 00 00 00 00 00 00 00 00 00 00 00 00 00 00 00 00 00 00 00 00 00 00 00 00 00 00 00 00 00 00 00 00 00 00 00 00 00 00 00 00 00 00 00 00 00 00 00 00 00 00 00 00 00 00 00 00 00 00 00 00 00 00 00 00 00 00 00 00 00 00 00 00 00 00
					39 01 00 00 00 00 86 cf 64 0b 00 00 00 00 00 12 04 00 0b 84 04 04 04 04 04 04 04 04 04 04 05 05 00 00 00 00 00 00 00 00 00 00 01 62 01 62 01 62 01 62 03 ff 02 e0 03 ff 00 00 00 00 00 00 00 00 00 00 01 62 01 62 01 62 01 62 03 ff 02 e0 03 ff 01 2e 01 2e 01 2e 01 2e 01 2e 01 2e 01 2e 01 2e 01 2e 01 2e 00 ff 00 ff 19 19 19 19 19 19 19 19 19 19 19 19 00 00 00 00 00 00 00 00 00 44 00 44 00 44 0f f1 0f f1 0f f1 0f f1 0f f1 19
					39 01 00 00 00 00 0f d0 44 44 b2 28 00 28 5a 00 5a 01 01 01 00 00
					39 01 00 00 00 00 42 d1 09 00 31 03 20 19 21 2d 22 00 00 00 00 00 00 00 00 00 00 00 00 00 00 00 00 00 00 00 00 00 00 00 00 00 00 00 00 00 00 00 00 00 00 00 00 00 00 00 00 00 00 00 00 00 00 00 00 00 00 00 00 00 00 00 01
					39 01 00 00 00 00 32 d3 45 00 00 01 32 45 00 00 01 61 77 77 77 07 82 00 00 a0 3c 9c 00 3e 6a 70 10 01 03 33 07 77 07 77 55 33 13 04 00 00 00 00 00 00 00 3c 00 00 01 00 00
					39 01 00 00 00 00 12 d4 00 32 00 00 40 10 00 00 00 00 00 00 00 00 00 02 00
					39 01 00 00 00 00 04 d5 00 00 00
					39 01 00 00 00 00 02 d6 00
					39 01 00 00 00 00 e0 d7 0a 00 0a 08 f0 ff 28 08 ff 00 00 00 02 00 03 0c f0 ff 28 08 0a 02 00 00 02 00 03 0c f0 ff 0a 08 28 00 00 00 00 00 00 00 00 00 00 00 00 00 00 00 05 00 05 06 00 01 28 88 28 02 00 00 00 00 01 0c f0 ff 28 08 1d 02 00 00 00 00 01 0b f0 ff 28 08 1d 02 00 00 00 00 00 00 00 00 00 00 00 00 00 00 00 00 00 00 00 00 00 00 00 00 00 00 00 00 00 00 00 00 00 00 00 00 00 00 00 00 00 00 00 00 00 00 00 00 00 00 00 00 00 00 00 00 00 00 00 00 00 00 00 00 00 00 00 00 00 00 00 00 00 00 00 00 00 00 00 00 00 00 00 00 00 00 00 00 00 00 00 00 00 00 00 00 00 00 00 00 00 00 00 00 00 00 00 00 00 00 00 00 00 00 00 00 00 00 00 00 00 00 00 00 00 00 00 00 00 00 00 00 00 00 00 00 00 00 00 00 00
					39 01 00 00 00 00 26 d8 00 05 00 17 00 05 46 00 46 6a 00 6a 00 6a 00 5c 00 ff 09 00 17 00 00 00 00 00 00 00 00 00 00 00 00 00 00 00 00
					39 01 00 00 00 00 62 d9 01 99 9a 86 87 88 8b 8c 00 00 00 00 00 00 00 00 00 00 00 00 00 00 00 00 00 00 00 00 00 00 00 00 00 00 00 00 00 00 00 00 00 00 8c 8b 88 87 8a 9a 99 19 1a 06 07 08 0b 0c 80 80 80 80 80 80 80 80 80 80 80 80 80 80 80 80 80 80 80 80 80 80 80 80 80 80 80 80 80 80 80 80 80 80 0c 0b 08 07 0a 1a 19
					39 01 00 00 00 00 05 dd 30 06 23 65
					39 01 00 00 00 00 0d de 41 10 10 00 4d 8b 55 4d 8b aa 4d 8b
					39 01 00 00 00 00 33 df 50 01 58 87 2d 05 35 15 01 31 11 3b 50 00 02 00 00 43 84 00 10 00 df d4 0e 00 00 00 00 00 00 00 0f 00 53 18 0f 00 1a 0f 00 1c 0f 00 00 00 00 00 00 00
					39 01 00 00 00 00 02 fa 00
					39 01 00 00 00 00 02 b0 80
					39 01 00 00 00 00 04 b2 41 08 00
					39 01 00 00 00 00 0f d0 9a b6 78 34 50 12 ba 98 76 54 32 10 80 00
					39 01 00 00 00 00 a8 d1 03 00 00 00 30 03 03 00 bc 15 00 00 07 00 e0 01 0a e8 40 05 00 a0 05 00 00 06 d9 03 00 04 02 00 08 37 20 84 1c 90 c3 1a b8 a1 1a 00 00 18 01 c0 8f 22 98 c8 11 50 24 0e 48 b2 0b 23 79 c3 5e cc a1 3b 96 90 20 49 58 90 09 34 c9 ea 8d e4 ff ff ff ff ff ff ff ff ff ff ff ff ff ff ff ff ff ff ff ff ff ff ff ff ff ff ff ff ff ff ff ff ff ff ff ff ff ff ff ff ff ff ff ff ff ff ff ff ff ff ff 6f 16 1a 04 4a 0e f2 a4 0e 79 62 87 40 89 45 b3 d8 62 5a 68 10 32 39 38 99 3a 9c 8c 1d 42 26 16 d3 62 8b 00 c0 03
					39 01 00 00 00 00 75 d2 1d 87 01 0f 00 00 5d 3e 00 3c cf f3 3c cf f3 3c cf f3 2c 16 8b c5 62 b1 58 2c 16 8b 95 d8 ff 0f 09 80 04 52 02 20 81 44 00 20 80 10 00 08 20 29 d5 0a 00 00 b5 a6 94 52 ad 00 00 50 6b 4a 84 58 4b 08 00 b5 a6 04 84 58 4b 08 00 ef bd 47 88 b5 84 00 f0 de 7b 29 d5 0a 00 00 b5 a6 04 0b 4c 00 00 00 13 2c 00 0c 90 c0 00 00 1e 78 60 81 09 00 00 60 82 05
					39 01 00 00 00 00 6d d3 00 ff ff ff 00 20 40 60 80 a0 c0 e0 ff 00 03 0c 1e 38 5b 89 c0 ff 00 03 0c 1e 38 5b 89 c0 ff 00 03 0c 1e 38 5b 89 c0 ff ff ff ff ff ff ff ff ff ff ff ff ff ff ff ff ff ff ff ff ff ff ff ff ff ff ff ff ff ff ff ff ff ff ff ff 80 80 80 80 80 80 80 80 80 80 80 80 80 80 80 80 80 80 80 80 80 80 80 80 80 80 80 80 80 80 80 80 80
					39 01 00 00 00 00 3c d4 93 90 40 1e e1 04 00 04 00 04 00 04 00 04 00 04 00 04 00 04 00 04 00 04 00 04 00 04 00 0f ff 00 00 0f ff 00 00 0f ff 00 00 03 20 00 df 00 c8 01 00 4d 8b 00 4d 8b 00 4d 8b 03 38
					39 01 00 00 00 00 05 dd c1 0d 00 02
					39 01 00 00 00 00 11 de 31 00 28 00 28 00 28 00 28 10 00 28 00 28 00 28
					39 01 00 00 00 00 5a df 53 09 00 00 00 10 00 10 32 28 28 50 55 55 55 55 50 55 55 55 55 50 00 00 00 00 03 84 00 00 00 7a 45 00 00 00 33 32 00 00 28 07 28 07 00 28 01 00 00 00 00 00 00 00 00 00 00 00 04 03 00 00 00 00 00 00 00 00 4c 00 01 00 00 00 00 00 00 00 00 00 00 00 00 00 00 00 00 00 00
					39 01 00 00 00 00 72 e4 dc 82 00 40 55 55 fd 40 55 55 fd 7f 55 55 01 00 00 00 00 40 55 55 fd 40 55 55 fd 40 55 55 fd 00 00 00 00 00 00 00 00 00 00 00 00 00 00 00 00 00 00 00 00 00 00 00 00 00 00 00 00 00 00 00 00 00 00 00 00 00 00 00 00 00 55 55 fd 00 00 7f c0 00 77 77 77 77 77 00 00 00 00 00 00 00 00 00 00 00 00 00 00 77 77 77 77 77 f3 00 33 07 00 00 00 00 00
					39 01 00 00 00 00 07 e5 ff 03 c0 ff 03 00
					39 01 00 00 00 00 02 e6 01
					39 01 00 00 00 00 02 35 00
					39 01 00 00 00 00 03 51 0f ff
					05 01 00 00 A0 00 02 11 00
					05 01 00 00 A0 00 02 29 00
				];
				qcom,mdss-dsi-off-command = [
					05 01 00 00 A0 00 02 28 00 
					05 01 00 00 A0 00 02 10 00];
				qcom,mdss-dsi-on-command-state = "dsi_lp_mode";
				qcom,mdss-dsi-off-command-state = "dsi_hs_mode";
				qcom,mdss-dsi-h-sync-pulse = <0>;
			};
		};
	};
};


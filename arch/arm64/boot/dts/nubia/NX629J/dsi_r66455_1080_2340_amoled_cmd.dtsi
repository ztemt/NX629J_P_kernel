/* Copyright (c) 2016-2017, The Linux Foundation. All rights reserved.
 *
 * This program is free software; you can redistribute it and/or modify
 * it under the terms of the GNU General Public License version 2 and
 * only version 2 as published by the Free Software Foundation.
 *
 * This program is distributed in the hope that it will be useful,
 * but WITHOUT ANY WARRANTY; without even the implied warranty of
 * MERCHANTABILITY or FITNESS FOR A PARTICULAR PURPOSE.  See the
 * GNU General Public License for more details.
 */

&mdss_mdp {
	dsi_r66455_1080_2340_amoled_cmd: qcom,mdss_dsi_r66455_1080_2340_amoled_cmd {
                qcom,mdss-dsi-panel-name = "dsi r66455 1080 2340 amoled command panel";
		qcom,mdss-dsi-panel-controller = <&mdss_dsi0>;
		qcom,mdss-dsi-panel-type = "dsi_cmd_mode";
		qcom,mdss-dsi-virtual-channel-id = <0>;
		qcom,mdss-dsi-stream = <0>;
		qcom,mdss-dsi-bpp = <24>;
		qcom,mdss-dsi-color-order = "rgb_swap_rgb";
		qcom,mdss-dsi-underflow-color = <0xff>;
		qcom,mdss-dsi-border-color = <0>;
		qcom,mdss-dsi-panel-blackness-level = <3230>;
	    qcom,mdss-dsi-traffic-mode = "burst_mode";
		qcom,mdss-dsi-bllp-eof-power-mode;
		qcom,mdss-dsi-bllp-power-mode;
		qcom,mdss-dsi-lane-0-state;
		qcom,mdss-dsi-lane-1-state;
		qcom,mdss-dsi-lane-2-state;
		qcom,mdss-dsi-lane-3-state;
		qcom,mdss-dsi-dma-trigger = "trigger_sw";
		qcom,mdss-dsi-mdp-trigger = "none";
		qcom,mdss-dsi-reset-sequence =<1 6>;
		qcom,mdss-dsi-bl-pmic-control-type = "bl_ctrl_dcs";
		qcom,mdss-dsi-bl-min-level = <1>;
		qcom,mdss-dsi-bl-max-level = <4095>;
		qcom,mdss-brightness-max-level = <4095>;
/*		qcom,adjust-timer-wakeup-ms = <1>;*/
		qcom,mdss-dsi-te-pin-select = <1>;
		qcom,mdss-dsi-wr-mem-start = <0x2c>;
		qcom,mdss-dsi-wr-mem-continue = <0x3c>;
		qcom,mdss-dsi-mode-sel-gpio-state = "single_port";
		qcom,panel-supply-entries = <&ztemt_dsi_panel_pwr_supply>;
/*		qcom,mdss-dsi-t-clk-post = <0x12>;
		qcom,mdss-dsi-t-clk-pre = <0x28>;
*/
		qcom,panel-mode-gpio = <&tlmm 7 0>;
		qcom,platform-te-gpio = <&tlmm 8 0>;
		qcom,platform-reset-gpio = <&tlmm 6 0>;
		qcom,panel_3p3_en_gpio = <&tlmm 130 0>;

		qcom,mdss-dsi-te-dcs-command = <1>;
		qcom,mdss-dsi-te-check-enable;
		qcom,mdss-dsi-te-using-te-pin;
		qcom,mdss-dsi-t-clk-post = <0x18>;
        qcom,mdss-dsi-t-clk-pre = <0x1A>;

		qcom,mdss-pan-physical-width-dimension = <72>;
		qcom,mdss-pan-physical-height-dimension = <156>;

/****************************************ESD CHECK START***********************************/
        qcom,esd-check-enabled;
		qcom,mdss-dsi-panel-status-command = [06 01 00 01 05 00 01 0a];
		qcom,mdss-dsi-panel-status-command-state = "dsi_lp_mode";
		qcom,mdss-dsi-panel-status-check-mode = "reg_read";
		qcom,mdss-dsi-panel-status-read-length = <1>;
		qcom,mdss-dsi-panel-max-error-count = <1>;
        qcom,mdss-dsi-panel-status-value = <0x1c>; 
/*****************************************ESD CHECK END*************************************/

		qcom,mdss-dsi-display-timings {
			timing@0{
				qcom,mdss-dsi-panel-framerate = <90>;
				qcom,mdss-dsi-panel-width = <1080>;
				qcom,mdss-dsi-panel-height = <2340>;
				qcom,mdss-dsi-h-front-porch = <270>;
				qcom,mdss-dsi-h-back-porch = <80>;
				qcom,mdss-dsi-h-pulse-width = <1>;
				qcom,mdss-dsi-h-sync-skew = <0>;
				qcom,mdss-dsi-v-back-porch = <12>;
				qcom,mdss-dsi-v-front-porch = <64>;
				qcom,mdss-dsi-v-pulse-width = <1>;
				qcom,mdss-dsi-h-left-border = <0>;
				qcom,mdss-dsi-h-right-border = <0>;
				qcom,mdss-dsi-v-top-border = <0>;
				qcom,mdss-dsi-v-bottom-border = <0>;
				qcom,mdss-dsi-panel-phy-timings = [00 1F 08 08 24 23 08 08 05 02 04 00 1A 18];
				qcom,display-topology = <1 1 1>;
				qcom,mdss-dsi-panel-jitter = <0x3C 0x0a>;
				qcom,default-topology-index = <0>;
				qcom,mdss-dsi-on-command = [
					39 01 00 00 00 00 02 b0 04
					39 01 00 00 00 00 02 b0 00
					39 01 00 00 00 00 02 b3 00
					39 01 00 00 00 00 02 bb 5b
					39 01 00 00 00 00 03 CB 00 00
					39 01 00 00 00 00 03 CA 00 00
					39 01 00 00 00 00 03 C9 00 00
					39 01 00 00 00 00 03 C8 00 00
					39 01 00 00 00 00 02 F1 30
					39 01 00 00 00 00 03 CB 00 00
					39 01 00 00 00 00 02 F1 30
					39 01 00 00 00 00 03 CA 00 00
					39 01 00 00 00 00 02 F1 30
					39 01 00 00 00 00 03 C9 00 00
					39 01 00 00 00 00 02 F1 30
					39 01 00 00 00 00 03 C8 00 00
					39 01 00 00 00 00 02 F1 60
					39 01 00 00 00 00 03 CB 00 00
					39 01 00 00 00 00 02 F1 60
					39 01 00 00 00 00 03 CA 00 00
					39 01 00 00 00 00 02 F1 60
					39 01 00 00 00 00 03 C9 00 00
					39 01 00 00 00 00 02 F1 60
					39 01 00 00 00 00 03 C8 00 00
					39 01 00 00 00 00 08 d8 00 05 00 17 00 05 47
					39 01 00 00 00 00 02 b0 80
					39 01 00 00 00 00 02 e6 00
					39 01 00 00 00 00 02 d6 00 
					39 01 00 00 00 00 02 b0 00
					39 01 00 00 00 00 08 b6 02 bb 07 00 1a 0a 1b
					39 01 00 00 00 00 03 eb 8B 8B
					39 01 00 00 00 00 02 f7 01
					39 01 00 00 00 00 5f f8 11 00 00 89 10 80 09 24 04 38 00 14 04 38 04 38 02 00 03 1C 00 20 02 05 00 0F 00 0C 02 67 02 2E 18 00 10 F0 03 0C 20 00 06 0B 0B 33 0E 1C 2A 38 46 54 62 69 70 77 79 7B 7D 7E 01 02 01 00 09 40 09 BE 19 FC 19 FA 19 F8 1A 38 1A 78 1A B6 2A F6 2B 34 2B 74 3B 74 6B F4 00 00 00 00 00 00
 					39 01 00 00 00 00 02 35 00
					39 01 00 00 00 00 03 51 00 00
					05 01 00 00 8C 00 02 11 00 
					05 01 00 00 00 00 02 29 00
				];
				qcom,mdss-dsi-off-command = [
					05 01 00 00 64 00 02 28 00  
					05 01 00 00 32 00 02 10 00];
				qcom,mdss-dsi-on-command-state = "dsi_lp_mode";
				qcom,mdss-dsi-off-command-state = "dsi_hs_mode";
				qcom,mdss-dsi-h-sync-pulse = <0>;
				qcom,compression-mode = "dsc";
				qcom,mdss-dsc-slice-height = <2340>;
				qcom,mdss-dsc-slice-width = <540>;
				qcom,mdss-dsc-slice-per-pkt = <2>;
				qcom,mdss-dsc-bit-per-component = <8>;
				qcom,mdss-dsc-bit-per-pixel = <8>;
				qcom,mdss-dsc-block-prediction-enable;
			};
		};
	};
};

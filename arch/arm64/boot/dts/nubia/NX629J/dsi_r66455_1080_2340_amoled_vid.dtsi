/* Copyright (c) 2016-2017, The Linux Foundation. All rights reserved.
 *
 * This program is free software; you can redistribute it and/or modify
 * it under the terms of the GNU General Public License version 2 and
 * only version 2 as published by the Free Software Foundation.
 *
 * This program is distributed in the hope that it will be useful,
 * but WITHOUT ANY WARRANTY; without even the implied warranty of
 * MERCHANTABILITY or FITNESS FOR A PARTICULAR PURPOSE.  See the
 * GNU General Public License for more details.
 */

&mdss_mdp {
	dsi_r66455_1080_2340_amoled_vid: qcom,mdss_dsi_r66455_1080_2340_amoled_vid {
                qcom,mdss-dsi-panel-name = "dsi r66455 1080 2340 amoled video panel";
		qcom,mdss-dsi-panel-controller = <&mdss_dsi0>;
		qcom,mdss-dsi-panel-type = "dsi_video_mode";
		qcom,mdss-dsi-virtual-channel-id = <0>;
		qcom,mdss-dsi-stream = <0>;
		qcom,mdss-dsi-bpp = <24>;
		qcom,mdss-dsi-color-order = "rgb_swap_rgb";
		qcom,mdss-dsi-underflow-color = <0xff>;
		qcom,mdss-dsi-border-color = <0>;
		qcom,mdss-dsi-panel-blackness-level = <3230>;
	    qcom,mdss-dsi-traffic-mode = "burst_mode";
		qcom,mdss-dsi-force-clock-lane-hs;
		qcom,mdss-dsi-bllp-eof-power-mode;
		qcom,mdss-dsi-bllp-power-mode;
		qcom,mdss-dsi-tx-eot-append;	
		qcom,mdss-dsi-post-init-delay = <1>;
		qcom,mdss-dsi-lane-0-state;
		qcom,mdss-dsi-lane-1-state;
		qcom,mdss-dsi-lane-2-state;
		qcom,mdss-dsi-lane-3-state;
		qcom,mdss-dsi-dma-trigger = "trigger_sw";
		qcom,mdss-dsi-mdp-trigger = "none";
		qcom,mdss-dsi-reset-sequence =<1 2>, <0 2>, <1 10>;
		qcom,mdss-dsi-bl-pmic-control-type = "bl_ctrl_dcs";
		qcom,mdss-dsi-bl-min-level = <1>;
		qcom,mdss-dsi-bl-max-level = <4095>;
		qcom,mdss-brightness-max-level = <4095>;
/*		qcom,adjust-timer-wakeup-ms = <1>;*/
/*		qcom,mdss-dsi-te-pin-select = <1>;*/
		qcom,mdss-dsi-wr-mem-start = <0x2c>;
		qcom,mdss-dsi-wr-mem-continue = <0x3c>;
		qcom,mdss-dsi-mode-sel-gpio-state = "single_port";
		qcom,panel-supply-entries = <&ztemt_dsi_panel_pwr_supply>;
/*		qcom,mdss-dsi-t-clk-post = <0x12>;
		qcom,mdss-dsi-t-clk-pre = <0x28>;
*/
		qcom,panel-mode-gpio = <&tlmm 7 0>;
		qcom,platform-te-gpio = <&tlmm 8 0>;
		qcom,platform-reset-gpio = <&tlmm 6 0>;
		qcom,panel_3p3_en_gpio = <&tlmm 130 0>;

/*		qcom,mdss-dsi-te-dcs-command = <1>;
		qcom,mdss-dsi-te-check-enable;
		qcom,mdss-dsi-te-using-te-pin;
        qcom,mdss-dsi-t-clk-post = <0x12>;
        qcom,mdss-dsi-t-clk-pre = <0x28>;
		*/

/****************************************ESD CHECK START***********************************/
        qcom,esd-check-enabled;
		qcom,mdss-dsi-panel-status-command = [06 01 00 01 05 00 01 0a];
		qcom,mdss-dsi-panel-status-command-state = "dsi_lp_mode";
		qcom,mdss-dsi-panel-status-check-mode = "reg_read";
		qcom,mdss-dsi-panel-status-read-length = <1>;
		qcom,mdss-dsi-panel-max-error-count = <1>;
        qcom,mdss-dsi-panel-status-value = <0x1c>; 
/*****************************************ESD CHECK END*************************************/

		qcom,mdss-dsi-display-timings {
			timing@0{
				qcom,mdss-dsi-panel-framerate = <90>;
				qcom,mdss-dsi-panel-width = <1080>;
				qcom,mdss-dsi-panel-height = <2340>;
				qcom,mdss-dsi-h-front-porch = <80>;
				qcom,mdss-dsi-h-back-porch = <40>;
				qcom,mdss-dsi-h-pulse-width = <1>;
				qcom,mdss-dsi-h-sync-skew = <0>;
				qcom,mdss-dsi-v-back-porch = <4>;
				qcom,mdss-dsi-v-front-porch = <10>;
				qcom,mdss-dsi-v-pulse-width = <1>;
				qcom,mdss-dsi-h-left-border = <0>;
				qcom,mdss-dsi-h-right-border = <0>;
				qcom,mdss-dsi-v-top-border = <0>;
				qcom,mdss-dsi-v-bottom-border = <0>;
				qcom,mdss-dsi-panel-phy-timings = [00 31 0D 0D 2B 28 0D 0D 09 02 04 00 27 1C];
				qcom,display-topology = <1 0 1>;
				qcom,default-topology-index = <0>;
				qcom,mdss-dsi-on-command = [
					39 01 00 00 00 00 02 b0 04
					39 01 00 00 00 00 05 e4 01 00 00 00
					39 01 00 00 00 00 02 b0 00
					39 01 00 00 00 00 02 b3 01 
					39 01 00 00 00 00 02 b0 80
					39 01 00 00 00 00 02 e6 01
					39 01 00 00 00 00 02 35 00
					39 01 00 00 00 00 03 51 00 00
					05 01 00 00 A0 00 02 11 00 
					05 01 00 00 00 00 02 29 00
				];
				qcom,mdss-dsi-off-command = [
					05 01 00 00 A0 00 02 28 00  
					05 01 00 00 78 00 02 10 00];
				nubia,mdss-dsi-cabc-command-off = [15 01 00 00 00 00 02 55 00];
				nubia,mdss-dsi-cabc-command-lever1 = [15 01 00 00 00 00 02 55 01];
				nubia,mdss-dsi-cabc-command-lever2 = [15 01 00 00 00 00 02 55 02];
				nubia,mdss-dsi-cabc-command-lever3 = [15 01 00 00 00 00 02 55 03];
			    nubia,mdss-dsi-cabc-command-off-state = "dsi_hs_mode";
				nubia,mdss-dsi-cabc-command-level1-state = "dsi_hs_mode";
				nubia,mdss-dsi-cabc-command-level2-state = "dsi_hs_mode";
				nubia,mdss-dsi-cabc-command-level3-state = "dsi_hs_mode";
				qcom,mdss-dsi-on-command-state = "dsi_lp_mode";
				qcom,mdss-dsi-off-command-state = "dsi_hs_mode";
				qcom,mdss-dsi-h-sync-pulse = <0>;

			};
		};
	};
};
